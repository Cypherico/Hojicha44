/*
 * Hojicha44 LEFT half overlay — the split central (see .github/workflows/
 * build.yml; the central role default lives in Kconfig.defconfig).
 *
 * Split traffic uses BLE. Leave the exposed TRRS debug pins inactive
 * in the standard firmware.
 */
#include "hojicha44.dtsi"

&uart0 {
    status = "disabled";
};

&left_encoder {
    status = "okay";
};
